## board/buildroot/configs/moodnas_ex4_defconfig
```kconfig
# MoodNAS for WD My Cloud EX4 — Buildroot defconfig (STATUS: draft, phase 5)
#   make BR2_EXTERNAL=/path/to/moodnas/board/buildroot moodnas_ex4_defconfig
#   make
BR2_arm=y
BR2_arm926t=y
BR2_ARM_EABI=y
BR2_TOOLCHAIN_BUILDROOT_GLIBC=y
BR2_TARGET_GENERIC_HOSTNAME="moodnas"
BR2_TARGET_GENERIC_ISSUE="MoodNAS by Mood Robotics"
BR2_INIT_BUSYBOX=y
BR2_SYSTEM_DHCP="eth0"
BR2_ROOTFS_OVERLAY="$(BR2_EXTERNAL_MOODNAS_PATH)/rootfs-overlay"

BR2_LINUX_KERNEL=y
BR2_LINUX_KERNEL_LATEST_VERSION=y
BR2_LINUX_KERNEL_USE_DEFCONFIG=y
BR2_LINUX_KERNEL_DEFCONFIG="multi_v5"
BR2_LINUX_KERNEL_CONFIG_FRAGMENT_FILES="$(BR2_EXTERNAL_MOODNAS_PATH)/../wd-mycloud-ex4/linux.fragment"
BR2_LINUX_KERNEL_DTS_SUPPORT=y
BR2_LINUX_KERNEL_CUSTOM_DTS_PATH="$(BR2_EXTERNAL_MOODNAS_PATH)/../wd-mycloud-ex4/kirkwood-wd-mycloud-ex4.dts"
BR2_LINUX_KERNEL_APPENDED_UIMAGE=y
BR2_LINUX_KERNEL_UIMAGE_LOADADDR="0x8000"

BR2_PACKAGE_MOODD=y
BR2_PACKAGE_SAMBA4=y
BR2_PACKAGE_NFS_UTILS=y
BR2_PACKAGE_WIREGUARD_TOOLS=y
BR2_PACKAGE_NFTABLES=y
BR2_PACKAGE_DROPBEAR=y
BR2_PACKAGE_E2FSPROGS=y
BR2_PACKAGE_LVM2=y
BR2_PACKAGE_HDPARM=y
BR2_PACKAGE_I2C_TOOLS=y
BR2_PACKAGE_KEXEC=y
BR2_PACKAGE_AVAHI=y
BR2_PACKAGE_AVAHI_DAEMON=y
BR2_PACKAGE_CHRONY=y

BR2_TARGET_ROOTFS_SQUASHFS=y
BR2_TARGET_ROOTFS_SQUASHFS4_XZ=y
```

## board/buildroot/package/moodd/Config.in
```kconfig
config BR2_PACKAGE_MOODD
	bool "moodd"
	depends on BR2_PACKAGE_HOST_GO_TARGET_ARCH_SUPPORTS
	select BR2_PACKAGE_SMARTMONTOOLS
	select BR2_PACKAGE_MDADM
	select BR2_PACKAGE_CA_CERTIFICATES
	help
	  MoodNAS daemon: web UI, REST API, local AI and hardware loop.
```
